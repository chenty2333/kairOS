## tools/busybox/kairos_defconfig
```kconfig
CONFIG_STATIC=y
# CONFIG_PIE is not set
CONFIG_BUSYBOX=y
CONFIG_LONG_OPTS=y
CONFIG_ASH=y
CONFIG_ASH_ALIAS=y
CONFIG_ASH_TEST=y
CONFIG_ASH_EXPAND_PRMT=y
CONFIG_SH_IS_ASH=y
CONFIG_FEATURE_SH_STANDALONE=y
CONFIG_FEATURE_PREFER_APPLETS=y
CONFIG_FEATURE_EDITING=y
CONFIG_FEATURE_EDITING_MAX_LEN=1024
CONFIG_FEATURE_EDITING_HISTORY=200
CONFIG_FEATURE_EDITING_SAVEHISTORY=y
CONFIG_FEATURE_TAB_COMPLETION=y
CONFIG_FEATURE_EDITING_FANCY_PROMPT=y
CONFIG_FEATURE_EDITING_WINCH=y
CONFIG_FEATURE_LS_COLOR=y
CONFIG_FEATURE_LS_COLOR_IS_DEFAULT=y
CONFIG_LS=y
CONFIG_CAT=y
CONFIG_ECHO=y
CONFIG_PWD=y
CONFIG_MKDIR=y
CONFIG_RMDIR=y
CONFIG_RM=y
CONFIG_CP=y
CONFIG_MV=y
CONFIG_TOUCH=y
CONFIG_LN=y
CONFIG_READLINK=y
CONFIG_STAT=y
CONFIG_HEAD=y
CONFIG_TAIL=y
CONFIG_WC=y
CONFIG_GREP=y
CONFIG_SED=y
CONFIG_AWK=y
CONFIG_CUT=y
CONFIG_TR=y
CONFIG_SORT=y
CONFIG_UNIQ=y
CONFIG_TEE=y
CONFIG_PRINTF=y
CONFIG_SLEEP=y
CONFIG_DATE=y
CONFIG_UNAME=y
CONFIG_DMESG=y
CONFIG_KILL=y
CONFIG_NICE=y
CONFIG_ID=y
CONFIG_WHOAMI=y
CONFIG_ENV=y
CONFIG_BASENAME=y
CONFIG_DIRNAME=y
CONFIG_WHICH=y
CONFIG_REALPATH=y
CONFIG_CHMOD=y
CONFIG_CHOWN=y
CONFIG_CHGRP=y
CONFIG_CHROOT=y
CONFIG_MKNOD=y
CONFIG_MKFIFO=y
CONFIG_MKTEMP=y
CONFIG_DF=y
CONFIG_DU=y
CONFIG_SYNC=y
CONFIG_MOUNT=y
CONFIG_UMOUNT=y
CONFIG_PS=y
CONFIG_PIDOF=y
CONFIG_PGREP=y
CONFIG_PKILL=y
CONFIG_KILLALL=y
CONFIG_FREE=y
CONFIG_UPTIME=y
CONFIG_TIME=y
CONFIG_TRUE=y
CONFIG_FALSE=y
CONFIG_YES=y
CONFIG_XARGS=y
CONFIG_FIND=y
CONFIG_EXPR=y
CONFIG_TEST=y
CONFIG_SEQ=y
CONFIG_DD=y
CONFIG_HEXDUMP=y
CONFIG_OD=y
CONFIG_STRINGS=y
CONFIG_COMM=y
CONFIG_CMP=y
CONFIG_DIFF=y
CONFIG_PASTE=y
CONFIG_FOLD=y
CONFIG_NL=y
CONFIG_VI=y
CONFIG_FEATURE_VI_COLON=y
CONFIG_FEATURE_VI_YANKMARK=y
CONFIG_FEATURE_VI_SEARCH=y
CONFIG_FEATURE_VI_USE_SIGNALS=y
CONFIG_FEATURE_VI_SET=y
CONFIG_AR=y
CONFIG_CPIO=y
CONFIG_GUNZIP=y
CONFIG_ZCAT=y
CONFIG_GZIP=y
CONFIG_TAR=y
CONFIG_FEATURE_TAR_LONG_OPTIONS=y
CONFIG_FEATURE_TAR_TO_COMMAND=y
CONFIG_UNZIP=y
CONFIG_BASE32=y
CONFIG_BASE64=y
CONFIG_CKSUM=y
CONFIG_CRC32=y
CONFIG_DOS2UNIX=y
CONFIG_EXPAND=y
CONFIG_FSYNC=y
CONFIG_HOSTID=y
CONFIG_INSTALL=y
CONFIG_LESS=y
CONFIG_FEATURE_LESS_MAXLINES=9999999
CONFIG_LINK=y
CONFIG_LOGNAME=y
CONFIG_MD5SUM=y
CONFIG_MORE=y
CONFIG_NOHUP=y
CONFIG_NPROC=y
CONFIG_PRINTENV=y
CONFIG_SHA1SUM=y
CONFIG_SHA256SUM=y
CONFIG_SHA3SUM=y
CONFIG_SHA512SUM=y
CONFIG_SHUF=y
CONFIG_SPLIT=y
CONFIG_SUM=y
CONFIG_TAC=y
CONFIG_TIMEOUT=y
CONFIG_TRUNCATE=y
CONFIG_TSORT=y
CONFIG_UNEXPAND=y
CONFIG_UNIX2DOS=y
CONFIG_UNLINK=y
CONFIG_WATCH=y
CONFIG_XXD=y
```
